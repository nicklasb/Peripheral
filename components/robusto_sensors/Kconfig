## components/robusto_sensors/Kconfig
```kconfig
menu "Robusto sensors"


      
    config ROBUSTO_LOAD_BMV700
        bool "BMV700"
        default n
        help
            Load library to read VE.Direct data from the Victron BMW700 series of battery monitors 
    
    rsource "bmv700/Kconfig"    
    config ROBUSTO_LOAD_DHT22
        bool "DHT22"
        default n
        help
            Load library to get data from the DHT22 temperature and humidity sensor. 
    rsource "dht22/Kconfig"
     
    config ROBUSTO_LOAD_DS1603L
    bool "DS1603L"
    default n
    help
        Load library to get data from the DHT22 temperature and humidity sensor. 
    rsource "ds1603l/Kconfig" 

    config ROBUSTO_LOAD_RESISTANCE
        bool "Resistance sensors"
        default n
        help
            Load library to get data from resistor-based sensors using voltage dividers.     

endmenu
```

## components/robusto_sensors/bmv700/Kconfig
```kconfig
menu "BMV 700-configuration"
    depends on ROBUSTO_LOAD_BMV700

    config ROBUSTO_BMV700_SIMULATION
        bool "Enable simulation mode"
        default "n"
        help
            This enables simulation mode, which makes the library return example data instead of querying the device.
            Normally, this is used for testing or display purposes.

endmenu
```

## components/robusto_sensors/dht22/Kconfig
```kconfig
menu "DHT22-configuration"
    depends on ROBUSTO_LOAD_DHT22

    config ROBUSTO_DHT22_SIMULATION
        bool "Enable simulation mode"
        default "n"
        help
            This enables simulation mode, which makes the library return example data instead of querying the device.
            Normally, this is used for testing or display purposes.

endmenu
```

## components/robusto_sensors/ds1603l/Kconfig
```kconfig
menu "DS1603l-configuration"
    depends on ROBUSTO_LOAD_DS1603L

    config ROBUSTO_DS1603L_SIMULATION
        bool "Enable simulation mode"
        default "n"
        help
            This enables simulation mode, which makes the library return example data instead of querying the device.
            Normally, this is used for testing or display purposes.

endmenu
```
